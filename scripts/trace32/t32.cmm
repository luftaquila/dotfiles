; this script must be linked to ~/.trace32/user-settings.cmm
; rm ~/.trace32/user-settings.cmm; ln -s ~/dotfiles/scripts/rtworks/t32.cmm ~/.trace32/user-settings.cmm

// GLOBAL &CPU
// &CPU="<something>"
DO ~/.trace32/cpu.cmm

RESet
SYStem.RESet

LOCAL &SETUP
&SETUP="~/dotfiles/scripts/trace32/&CPU.cmm"

DO &SETUP

WAIT 100ms
SYStem.Attach

Break

; load elfs
Data.Load.ELF ~/rtworks/builder/build.kernel/rtworks.elf /NoCode
Data.Load.ELF ~/rtworks/builder/build.partition1/rtworks_partition.elf /nocode /noclear

; open default windows
DO ~/dotfiles/scripts/trace32/windows.cmm

