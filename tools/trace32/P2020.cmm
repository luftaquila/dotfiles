SYStem.CPU P2020
SYStem.Option FREEZE ON
SPE.View
